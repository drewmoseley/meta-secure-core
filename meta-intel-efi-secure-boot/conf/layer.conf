## meta-intel-efi-secure-boot/conf/layer.conf
```bitbake
# We have a conf and classes directory, add to BBPATH
BBPATH .= ":${LAYERDIR}"

# We have recipes-* directories, add to BBFILES
BBFILES += "${LAYERDIR}/recipes-*/*/*.bb \
	${LAYERDIR}/recipes-*/*/*.bbappend"

BBFILE_COLLECTIONS += "intel-efi-secure-boot"
BBFILE_PATTERN_intel-efi-secure-boot = "^${LAYERDIR}/"
BBFILE_PRIORITY_intel-efi-secure-boot = "11"

BBLAYERS_LAYERINDEX_NAME_intel-efi-secure-boot = "meta-intel-efi-secure-boot"

LAYERDEPENDS_intel-efi-secure-boot = "\
    efi-secure-boot \
    intel \
"

LAYERSERIES_COMPAT_intel-efi-secure-boot = "thud warrior zeus"
```
